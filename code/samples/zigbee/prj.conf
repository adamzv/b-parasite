## CMakeLists.txt
```
cmake_minimum_required(VERSION 3.20.0)
find_package(Zephyr REQUIRED HINTS $ENV{ZEPHYR_BASE})
project("b-parasite Zigbee sample")

include_directories(src)

get_filename_component(PRST_SOURCE_ROOT "${CMAKE_CURRENT_SOURCE_DIR}/../../.." ABSOLUTE)
set(PRST_IDENTITY_SCRIPT "${PRST_SOURCE_ROOT}/code/scripts/firmware_identity.py")
set(PRST_IDENTITY_DIR "${CMAKE_CURRENT_BINARY_DIR}/generated")
set(PRST_GENERATED_CONFIG "${CMAKE_CURRENT_BINARY_DIR}/zephyr/.config")
file(GLOB_RECURSE PRST_IDENTITY_INPUTS CONFIGURE_DEPENDS
  "${CMAKE_CURRENT_SOURCE_DIR}/src/*.c"
  "${CMAKE_CURRENT_SOURCE_DIR}/src/*.h"
  "${PRST_SOURCE_ROOT}/code/prstlib/src/*.c"
  "${PRST_SOURCE_ROOT}/code/prstlib/src/*.h"
  "${PRST_SOURCE_ROOT}/code/prstlib/include/*.c"
  "${PRST_SOURCE_ROOT}/code/prstlib/include/*.h"
  "${PRST_SOURCE_ROOT}/code/prstlib/boards/*"
  "${PRST_SOURCE_ROOT}/code/prstlib/dts/*"
  "${PRST_SOURCE_ROOT}/code/prstlib/zephyr/*"
)
file(GLOB PRST_IDENTITY_CONFIG_INPUTS CONFIGURE_DEPENDS
  "${CMAKE_CURRENT_SOURCE_DIR}/Kconfig*"
  "${CMAKE_CURRENT_SOURCE_DIR}/prj*.conf"
  "${CMAKE_CURRENT_SOURCE_DIR}/*.overlay"
  "${PRST_SOURCE_ROOT}/code/prstlib/Kconfig*"
  "${PRST_SOURCE_ROOT}/code/prstlib/prj*.conf"
  "${PRST_SOURCE_ROOT}/code/prstlib/*.overlay"
)
set_property(DIRECTORY APPEND PROPERTY CMAKE_CONFIGURE_DEPENDS
  ${PRST_IDENTITY_INPUTS} ${PRST_IDENTITY_CONFIG_INPUTS}
  "${PRST_SOURCE_ROOT}/code/prstlib/CMakeLists.txt"
  "${PRST_GENERATED_CONFIG}" "${PRST_IDENTITY_SCRIPT}"
)
execute_process(
  COMMAND ${PYTHON_EXECUTABLE} "${PRST_IDENTITY_SCRIPT}"
    --source-root "${PRST_SOURCE_ROOT}"
    --config "${PRST_GENERATED_CONFIG}"
    --output-dir "${PRST_IDENTITY_DIR}"
    --metadata "zephyr=${KERNEL_VERSION_STRING}"
    --metadata "zephyr_sdk=${SDK_VERSION}"
    --metadata "compiler=${CMAKE_C_COMPILER_ID}-${CMAKE_C_COMPILER_VERSION}"
  RESULT_VARIABLE PRST_IDENTITY_RESULT
  OUTPUT_VARIABLE PRST_IDENTITY
  OUTPUT_STRIP_TRAILING_WHITESPACE
)
if(NOT PRST_IDENTITY_RESULT EQUAL 0)
  message(FATAL_ERROR "Failed to generate firmware build identity")
endif()
message(STATUS "b-parasite firmware identity: ${PRST_IDENTITY}")
target_include_directories(app PRIVATE "${PRST_IDENTITY_DIR}")

target_sources(app PRIVATE
  src/main.c
  src/boot_loop_guard.c
  src/debug_counters.c
  src/double_reset_detector.c
  src/factory_reset.c
  src/flash_fs.c
  src/prst_zb_attrs.c
  src/prst_zb_soil_moisture_defs.c
  src/prst_zb_soil_calibration.c
  src/restart_handler.c
  src/watchdog.c
)

target_link_libraries(app PUBLIC prstlib)
```

## Kconfig
```
source "Kconfig.zephyr"

config PRST_ZB_SLEEP_DURATION_SEC
	int "Sleep duration between waking up and reading sensors in seconds."
	default 60

config PRST_ZB_PARENT_POLL_INTERVAL_SEC
	int "Interval for when b-parasite polls its parent for data in seconds."
	default 10

config PRST_ZB_INTERVIEW_POLL_INTERVAL_MS
	int "Parent poll interval right after joining, so the coordinator's interview gets timely answers."
	default 1000

config PRST_ZB_BUTTON_POLL_DURATION_SEC
    int "Receive window after a single SW1 measurement request."
    range 1 300
    default 60

config PRST_ZB_INTERVIEW_DURATION_SEC
	int "How long to keep the fast interview poll interval before switching to the regular one."
	default 180

config PRST_ZB_CALIBRATION_SLEEP_DURATION_SEC
	int "Sensor read interval in calibration mode, which a short SW1 press starts."
	default 10

config PRST_ZB_CALIBRATION_DURATION_SEC
	int "How long calibration mode lasts after the last SW1 press."
	default 900

config PRST_ZB_CALIBRATION_SETTLE_SEC
	int "Wait before the first dry/wet capture reading, while the soil around a freshly inserted probe settles."
	default 180

config PRST_ZB_CALIBRATION_CAPTURE_SAMPLES
	int "Readings whose median becomes the dry (SW1 x2) or wet (SW1 x3) calibration point."
	default 9

config PRST_ZB_BUTTON_MULTI_PRESS_GAP_MS
	int "Pause after the last SW1 press that ends a multi-press sequence."
	default 800

config PRST_ZB_BUILD_DATE
  string "Zigbee basic cluster build date attribute. Max 16 bytes."
  default ""

config PRST_ZB_MODEL_ID
  string "Zigbee basic cluster model id attribute. Max 32 bytes."
  default "b-parasite"

config PRST_ZB_HARDWARE_VERSION
  int "Zigbee basic cluster hardware version attribute. 1 byte."
  default BOARD_REVISION_CODE

choice PRST_ZB_FACTORY_RESET_METHOD
  bool "Factory reset method"
  default PRST_ZB_FACTORY_RESET_VIA_SW1

config PRST_ZB_FACTORY_RESET_VIA_DOUBLE_RESET
  bool "Double resetting factory resets the device."

config PRST_ZB_FACTORY_RESET_VIA_RESET_PIN
  bool "Resetting via the reset pin will factory reset the device. Power cycling through battery replacement will not."

config PRST_ZB_FACTORY_RESET_VIA_SW1
  bool "Resetting while pressing and holding SW1 for 5 seconds will factory reset the device. Only available on v2.0.0+ hardware revisions."

config PRST_ZB_FACTORY_RESET_DISABLED
  bool "No factory reset procedure."

endchoice  # PRST_ZB_FACTORY_RESET_METHOD

config PRST_ZB_BOOT_LOOP_LIMIT
    int "Crash resets in a row, without a stable run between them, after which boot waits before starting Zigbee."
    default 5

config PRST_ZB_BOOT_LOOP_BACKOFF_SEC
    int "How long a boot waits, radio off, once PRST_ZB_BOOT_LOOP_LIMIT is reached."
    default 3600

config PRST_ZB_RESTART_WATCHDOG_TIMEOUT_SEC
    int "Initial pause before retrying network recovery until explicitly stopped."
    range 1 2147483647
    default 3600

config PRST_ZB_RESTART_WATCHDOG_MAX_TIMEOUT_SEC
    int "Maximum pause between recovery requests, doubling after each request."
    range PRST_ZB_RESTART_WATCHDOG_TIMEOUT_SEC 2147483647
    default 7200
```

## prj.conf
```kconfig
# Logs and RTT keep the CPU busy formatting messages nobody reads in the field; prj_debug.conf has them.
CONFIG_LOG=n
CONFIG_PWM=y
CONFIG_I2C=y
CONFIG_ADC=y
CONFIG_GPIO=y

CONFIG_USE_SEGGER_RTT=n

CONFIG_NEWLIB_LIBC=y
CONFIG_NEWLIB_LIBC_FLOAT_PRINTF=y

CONFIG_SERIAL=n

CONFIG_HEAP_MEM_POOL_SIZE=2048
CONFIG_MAIN_THREAD_PRIORITY=7

CONFIG_ZIGBEE_ADD_ON=y
CONFIG_ZIGBEE_APP_UTILS=y
CONFIG_ZIGBEE_ROLE_END_DEVICE=y

# This example requires more workqueue stack
CONFIG_SYSTEM_WORKQUEUE_STACK_SIZE=2048

# Enable nRF ECB driver
CONFIG_CRYPTO=y
CONFIG_CRYPTO_NRF_ECB=y
CONFIG_CRYPTO_INIT_PRIORITY=80

# Networking
CONFIG_NET_IPV6=n
CONFIG_NET_IPV6_MLD=n
CONFIG_NET_IPV6_NBR_CACHE=n
CONFIG_NET_IPV6_RA_RDNSS=n
CONFIG_NET_IP_ADDR_CHECK=n
CONFIG_NET_UDP=n

##
## ZigBee Channel Selection
##
CONFIG_ZIGBEE_CHANNEL_SELECTION_MODE_MULTI=y
CONFIG_ZIGBEE_CHANNEL_MASK=0x07FFF800

# Enable API for powering down unused RAM parts.
# https://developer.nordicsemi.com/nRF_Connect_SDK/doc/1.7.1/nrf/ug_zigbee_configuring.html#power-saving-during-sleep
CONFIG_RAM_POWER_DOWN_LIBRARY=y

# LittleFS.
CONFIG_MAIN_STACK_SIZE=2048
CONFIG_FLASH=y
CONFIG_FLASH_MAP=y
CONFIG_FLASH_PAGE_LAYOUT=y
CONFIG_FILE_SYSTEM=y
CONFIG_FILE_SYSTEM_LITTLEFS=y

CONFIG_WATCHDOG=y
CONFIG_HWINFO=y
# Must stay on: several __ASSERT() calls wrap required calls (watchdog start, factory reset check)
# and are compiled out entirely when asserts are disabled.
CONFIG_ASSERT=y

# Uncomment for debug log level.
# CONFIG_LOG_DEFAULT_LEVEL=4

# Factory reset method selection. Only hardware revision 2.0.0+ has button SW1. Earlier
# revisions must select a different method. See Kconfig for options.
# CONFIG_PRST_ZB_FACTORY_RESET_VIA_SW1=y

# Soil changes over hours, and each poll wakes the radio; both trade latency for CR2032 life.
CONFIG_PRST_ZB_SLEEP_DURATION_SEC=600
CONFIG_PRST_ZB_PARENT_POLL_INTERVAL_SEC=30

# Allow the SDK's Trust Center rejoin before pausing between recovery rounds.
CONFIG_ZIGBEE_DEV_REJOIN_TIMEOUT_MS=360000
CONFIG_PRST_ZB_RESTART_WATCHDOG_TIMEOUT_SEC=600
CONFIG_PRST_ZB_RESTART_WATCHDOG_MAX_TIMEOUT_SEC=7200
```

## src/boot_loop_guard.c
```c
#include "boot_loop_guard.h"

#include <errno.h>
#include <zephyr/fs/fs.h>
#include <zephyr/kernel.h>
#include <zephyr/logging/log.h>
#include <zephyr/sys/atomic.h>

LOG_MODULE_REGISTER(boot_loop_guard, CONFIG_LOG_DEFAULT_LEVEL);

// The legacy boots_since_join file counted every boot, not just crashes.
static const char kBootsFile[] = "/lfs/crash_boots";
static atomic_t clear_requested;

uint32_t prst_boot_loop_guard_register_boot(bool crash_reset) {
  if (!crash_reset) {
    int err = fs_unlink(kBootsFile);
    if (err != 0 && err != -ENOENT) {
      LOG_ERR("Unable to clear %s: %d", kBootsFile, err);
    }
    return 0;
  }
  struct fs_file_t file;
  fs_file_t_init(&file);
  int err = fs_open(&file, kBootsFile, FS_O_CREATE | FS_O_RDWR);
  if (err != 0) {
    LOG_ERR("Unable to open %s: %d", kBootsFile, err);
    return 0;
  }

  uint32_t boots = 0;
  ssize_t bytes = fs_read(&file, &boots, sizeof(boots));
  if (bytes != 0 && bytes != (ssize_t)sizeof(boots)) {
    err = bytes < 0 ? (int)bytes : -EIO;
  }
  if (!err) {
    err = fs_seek(&file, 0, FS_SEEK_SET);
  }
  if (!err) {
    const uint32_t next = boots + 1;
    bytes = fs_write(&file, &next, sizeof(next));
    if (bytes != (ssize_t)sizeof(next)) {
      err = bytes < 0 ? (int)bytes : -EIO;
    }
  }
  // LittleFS releases its handle even when close reports a sync failure.
  int close_err = fs_close(&file);
  if (err || close_err) {
    LOG_ERR("Crash boot count unconfirmed: operation=%d, close=%d", err, close_err);
    return 0;
  }
  return boots;
}

// Flash writes stall the radio, so they stay off the Zigbee thread.
static void clear_work_handler(struct k_work* work) {
  int err = fs_unlink(kBootsFile);
  if (err != 0 && err != -ENOENT) {
    LOG_ERR("Unable to clear %s: %d", kBootsFile, err);
    atomic_clear(&clear_requested);
  }
}

K_WORK_DEFINE(clear_work, clear_work_handler);

void prst_boot_loop_guard_clear_async() {
  if (atomic_cas(&clear_requested, 0, 1)) {
    int err = k_work_submit(&clear_work);
    if (err < 0) {
      LOG_ERR("Unable to schedule crash count clear: %d", err);
      atomic_clear(&clear_requested);
    }
  }
}
```

## src/boot_loop_guard.h
```c
#ifndef _PRST_ZB_BOOT_LOOP_GUARD_H_
#define _PRST_ZB_BOOT_LOOP_GUARD_H_

#include <stdbool.h>
#include <stdint.h>

// Returns the confirmed crash count before this boot; other resets clear the streak.
// Uses crash-only storage, leaving legacy all-boot counts untouched. FS errors return zero.
uint32_t prst_boot_loop_guard_register_boot(bool crash_reset);

// Clears the count off the Zigbee thread; a failed clear can be requested again.
void prst_boot_loop_guard_clear_async();

#endif  // _PRST_ZB_BOOT_LOOP_GUARD_H_
```

## src/debug_counters.c
```c
#include "debug_counters.h"

#include <errno.h>
#include <prstlib/macros.h>
#include <string.h>
#include <zephyr/fs/fs.h>
#include <zephyr/fs/littlefs.h>
#include <zephyr/kernel.h>
#include <zephyr/logging/log.h>

LOG_MODULE_REGISTER(debug_counters, CONFIG_LOG_DEFAULT_LEVEL);

static const char kDebugCountersDir[] = "/lfs/debug_counters";

#define PRST_MAX_COUNTER_NAME_LENGTH 64
#define PRST_MAX_FILE_NAME_LENGTH (sizeof(kDebugCountersDir) + 1 + PRST_MAX_COUNTER_NAME_LENGTH)

static int mk_filename(const char* counter_name, char* buff, size_t buff_size) {
  RET_CHECK(strlen(counter_name) <= PRST_MAX_COUNTER_NAME_LENGTH, "Counter name too long");
  strcpy(buff, kDebugCountersDir);
  strcat(buff, "/");
  strcat(buff, counter_name);
  return 0;
}

static int read_counter_file(struct fs_file_t* file, prst_debug_counter_t* value) {
  int n_read = fs_read(file, value, sizeof(prst_debug_counter_t));
  if (n_read != sizeof(prst_debug_counter_t)) {
    LOG_WRN("fs_read returned %d, expected %d, assuming first access", n_read, sizeof(prst_debug_counter_t));
    *value = 0;
  }
  return 0;
}

int prst_debug_counters_init() {
  struct fs_dirent entry;
  int err = fs_stat(kDebugCountersDir, &entry);
  if (err == 0) {
    LOG_DBG("Directory %s already exists", kDebugCountersDir);
    return 0;
  } else if (err == -ENOENT) {
    LOG_DBG("Creating directory %s", kDebugCountersDir);
    return fs_mkdir(kDebugCountersDir);
  }
  LOG_ERR("Unexpected error in fs_stat for %s: %d", kDebugCountersDir, err);
  return err;
}

int prst_debug_counters_increment(const char* counter_name) {
  char filename[PRST_MAX_FILE_NAME_LENGTH];
  RET_IF_ERR(mk_filename(counter_name, filename, sizeof(filename)));

  LOG_DBG("Incrementing counter %s", filename);

  // Open the file.
  struct fs_file_t file;
  fs_file_t_init(&file);
  RET_IF_ERR(fs_open(&file, filename, FS_O_CREATE | FS_O_RDWR));
  // LittleFS has only a few file slots; a handle leaked on an error path would make every later fs_open fail,
  // calibration and boot-loop guard included.
  prst_debug_counter_t value;
  read_counter_file(&file, &value);
  value++;
  int err = fs_seek(&file, 0, SEEK_SET);
  if (!err) {
    ssize_t written = fs_write(&file, &value, sizeof(value));
    if (written != sizeof(value)) {
      LOG_ERR("fs_write returned %d, expected %d", written, sizeof(value));
    }
    err = fs_sync(&file);
  }
  int close_err = fs_close(&file);
  return err ? err : close_err;
}

int prst_debug_counters_get(const char* counter_name, prst_debug_counter_t* value) {
  char filename[PRST_MAX_FILE_NAME_LENGTH];
  RET_IF_ERR(mk_filename(counter_name, filename, sizeof(filename)));

  LOG_DBG("Getting counter %s", filename);

  // Open the file.
  struct fs_file_t file;
  fs_file_t_init(&file);
  RET_IF_ERR(fs_open(&file, filename, FS_O_CREATE | FS_O_READ));
  // Read the current value.
  RET_IF_ERR(read_counter_file(&file, value));
  return fs_close(&file);
}

int prst_debug_counters_get_all(prst_debug_counters_callback_t callback) {
  LOG_DBG("Getting all counters from %s", kDebugCountersDir);

  struct fs_dir_t dirp;
  fs_dir_t_init(&dirp);
  static struct fs_dirent entry;
  RET_IF_ERR(fs_opendir(&dirp, kDebugCountersDir));
  prst_debug_counter_t value;
  for (;;) {
    RET_IF_ERR(fs_readdir(&dirp, &entry));
    // End of directory;
    if (entry.name[0] == 0) {
      break;
    }
    LOG_DBG("Found %s", entry.name);
    prst_debug_counters_get(entry.name, &value);
    callback(entry.name, value);
  }
  return fs_closedir(&dirp);
}

K_MSGQ_DEFINE(counter_requests, PRST_MAX_COUNTER_NAME_LENGTH + 1, 8, 1);

static void increment_work_handler(struct k_work* work) {
  char counter_name[PRST_MAX_COUNTER_NAME_LENGTH + 1];
  while (k_msgq_get(&counter_requests, counter_name, K_NO_WAIT) == 0) {
    int err = prst_debug_counters_increment(counter_name);
    if (err) {
      LOG_ERR("Unable to increment counter %s: %d", counter_name, err);
    }
  }
}

K_WORK_DEFINE(increment_work, increment_work_handler);

int prst_debug_counters_increment_async(const char* counter_name) {
  if (!counter_name || !counter_name[0]) {
    return -EINVAL;
  }
  char request[PRST_MAX_COUNTER_NAME_LENGTH + 1] = {0};
  size_t length = strnlen(counter_name, sizeof(request));
  if (length == sizeof(request)) {
    return -ENAMETOOLONG;
  }
  memcpy(request, counter_name, length);
  int queue_err = k_msgq_put(&counter_requests, request, K_NO_WAIT);
  // Even a full queue must retry work left pending by an earlier submit failure.
  int submit_err = k_work_submit(&increment_work);
  return queue_err ? queue_err : (submit_err < 0 ? submit_err : 0);
}
```

## src/debug_counters.h
```c
#ifndef _PRST_DEBUG_COUNTERS_H_
#define _PRST_DEBUG_COUNTERS_H_

#include <stdint.h>

typedef uint32_t prst_debug_counter_t;

typedef void (*prst_debug_counters_callback_t)(const char* counter_name, prst_debug_counter_t value);

int prst_debug_counters_init();

int prst_debug_counters_increment(const char* counter_name);

// Copies a name (up to 64 bytes) without FS access or waiting; safe from ISR/Zigbee context.
// A submit failure retains the request; the next valid call retries scheduling it.
int prst_debug_counters_increment_async(const char* counter_name);

int prst_debug_counters_get(const char* counter_name, prst_debug_counter_t* value);

int prst_debug_counters_get_all(prst_debug_counters_callback_t callback);

#endif  // _PRST_DEBUG_COUNTERS_H_
```

## src/double_reset_detector.c
```c
#include "double_reset_detector.h"

#include <prstlib/macros.h>
#include <string.h>
#include <zephyr/fs/fs.h>
#include <zephyr/fs/littlefs.h>
#include <zephyr/kernel.h>
#include <zephyr/logging/log.h>

#include "debug_counters.h"

LOG_MODULE_REGISTER(double_reset_detector, CONFIG_LOG_DEFAULT_LEVEL);

static const char* flag_filename = "/lfs/reset_flag";

static const char flag_prefix[] = "prst-rst-count";

static struct fs_file_t flag_file;

static int erase_flag() {
  return fs_unlink(flag_filename);
}

void erase_flag_callback(struct k_work* work) {
  LOG_INF("Erasing double reset flag.");
  if (erase_flag() != 0) {
    LOG_ERR("Error deleting flag");
  }
}

K_WORK_DELAYABLE_DEFINE(erase_flag_work, erase_flag_callback);

int prst_detect_double_reset(prst_double_reset_callback_t on_double_reset) {
  fs_file_t_init(&flag_file);

  RET_IF_ERR(fs_open(&flag_file, flag_filename, FS_O_CREATE | FS_O_RDWR));

  char buff[sizeof(flag_prefix)];
  RET_CHECK(fs_read(&flag_file, buff, sizeof(buff)) >= 0, "Unable to read file");

  // Consider it a double reset if the flag is present in the FS.
  if (strcmp(buff, flag_prefix) == 0) {
    RET_IF_ERR(fs_close(&flag_file));
    RET_IF_ERR(erase_flag());
    prst_debug_counters_increment("double_reset");
    return on_double_reset();
  }

  // Rewind file.
  RET_IF_ERR(fs_seek(&flag_file, 0, SEEK_SET));

  // Write the flag and erase it after some time.
  ssize_t written = fs_write(&flag_file, flag_prefix, sizeof(flag_prefix));
  if (written != sizeof(flag_prefix)) {
    LOG_ERR("fs_write returned %d, expected %d", written, sizeof(flag_prefix));
    return -1;
  }

  RET_IF_ERR(fs_close(&flag_file));

  // Schedule the erasure of the flag after some time.
  RET_CHECK(k_work_schedule(&erase_flag_work, K_SECONDS(5)) == 1,
            "Work not scheduled");

  return 0;
}
```

## src/factory_reset.c
```c
#include "factory_reset.h"

#include <hal/nrf_power.h>
#include <prstlib/button.h>
#include <prstlib/led.h>
#include <zephyr/logging/log.h>
#include <zigbee/zigbee_app_utils.h>

#include "double_reset_detector.h"

LOG_MODULE_REGISTER(factory_reset, CONFIG_LOG_DEFAULT_LEVEL);

static int factory_reset() {
  LOG_WRN("Factory resetting device");
  zb_bdb_reset_via_local_action(/*param=*/0);
  return 0;
}

#if CONFIG_PRST_ZB_FACTORY_RESET_VIA_DOUBLE_RESET
int double_reset_handler() {
  LOG_WRN("Called double reset handler");
  prst_led_flash(5);
  return factory_reset();
}
#endif  // CONFIG_PRST_ZB_FACTORY_RESET_VIA_DOUBLE_RESET

#if CONFIG_PRST_ZB_FACTORY_RESET_VIA_RESET_PIN
static int factory_reset_if_reset_via_reset_pin() {
  uint32_t reset_reason = nrf_power_resetreas_get(NRF_POWER);
  // If we're resetting via the RESET pin (e.g.: reset pin shorting, firmware flashing).
  if (reset_reason & 0x1) {
    LOG_WRN("Manual reset / re-flashing detected - erasing pairing info");
    return factory_reset();
  } else {  // It's a power-on cycle (e.g.: swapping battery, first boot).
    LOG_INF("Power-on cycle - keeping pairing info");
  }
  return 0;
}
#endif  // CONFIG_PRST_ZB_FACTORY_RESET_VIA_RESET_PIN

#if CONFIG_PRST_ZB_FACTORY_RESET_VIA_SW1
static void timer_do_reset(zb_uint8_t unused_param) {
  LOG_WRN("SW1 button was pressed for 5 seconds, factory resetting device");
  prst_led_flash(/*times=*/5);
  factory_reset();
}

static void sw1_factory_reset_check_timer_cb(struct k_timer* timer_id) {
  if (!prst_button_poll(PRST_BUTTON_SW1)) {
    LOG_DBG("SW1 button was released, will not factory reset device");
    return;
  }
  // Timer callbacks run in an ISR; only zigbee_schedule_callback() may hand work to ZBOSS from there.
  zigbee_schedule_callback(timer_do_reset, /*param=*/0);
}

K_TIMER_DEFINE(sw1_factory_reset_check_timer, sw1_factory_reset_check_timer_cb, NULL);
#endif

int prst_zb_factory_reset_check() {
#if CONFIG_PRST_ZB_FACTORY_RESET_VIA_DOUBLE_RESET
  return prst_detect_double_reset(double_reset_handler);
#elif CONFIG_PRST_ZB_FACTORY_RESET_VIA_RESET_PIN
  return factory_reset_if_reset_via_reset_pin();
#elif CONFIG_PRST_ZB_FACTORY_RESET_VIA_SW1
  if (prst_button_poll(PRST_BUTTON_SW1)) {
    LOG_DBG("SW1 pressed. Scheduling timer");
    k_timer_start(&sw1_factory_reset_check_timer, K_SECONDS(5), K_NO_WAIT);
  }
  return 0;
#elif CONFIG_PRST_ZB_FACTORY_RESET_DISABLED
  return 0;
#else
#error "No factory reset method selected -- explicitly select CONFIG_PRST_ZB_FACTORY_RESET_DISABLED=y to disable it"
#endif  // CONFIG_PRST_ZB_FACTORY_RESET_VIA_RESET_PIN
}
```

## src/flash_fs.c
```c
#include "flash_fs.h"

#include <prstlib/macros.h>
#include <zephyr/fs/fs.h>
#include <zephyr/fs/littlefs.h>
#include <zephyr/logging/log.h>

LOG_MODULE_REGISTER(flash_fs, CONFIG_LOG_DEFAULT_LEVEL);

FS_LITTLEFS_DECLARE_DEFAULT_CONFIG(storage);

static struct fs_mount_t lfs_storage_mnt = {
    .type = FS_LITTLEFS,
    .fs_data = &storage,
    .storage_dev = (void*)FIXED_PARTITION_ID(storage_partition),
    .mnt_point = "/lfs",
};

int prst_flash_fs_init() {
  // TODO: if booting for the first time after a full flash erase, fs_mount will
  // complain (via a LOG_ERR) and then automatically format the flash. It all works,
  // but avoiding a scary red message would be ideal. Maybe somehow check if it's
  // formatted before mounting?
  RET_IF_ERR(fs_mount(&lfs_storage_mnt));
  return 0;
}
```

## src/prst_zb_attrs.c
```c
#include "prst_zb_attrs.h"

#include <zboss_api_addons.h>

#include "bparasite_build_identity.h"
#include "prst_zb_endpoint_defs.h"

void prst_zb_attrs_init(struct zb_device_ctx* dev_ctx) {
  // A runtime pointer keeps the identity literal available for image inspection.
  static const char* volatile build_id = PRST_FIRMWARE_BUILD_ID;
  dev_ctx->basic_attr.zcl_version = ZB_ZCL_VERSION;
  dev_ctx->basic_attr.power_source = ZB_ZCL_BASIC_POWER_SOURCE_BATTERY;
  ZB_ZCL_SET_STRING_VAL(
      dev_ctx->basic_attr.mf_name,
      PRST_BASIC_MANUF_NAME,
      ZB_ZCL_STRING_CONST_SIZE(PRST_BASIC_MANUF_NAME));

  ZB_ZCL_SET_STRING_VAL(
      dev_ctx->basic_attr.model_id,
      CONFIG_PRST_ZB_MODEL_ID,
      ZB_ZCL_STRING_CONST_SIZE(CONFIG_PRST_ZB_MODEL_ID));

  ZB_ZCL_SET_STRING_VAL(
      dev_ctx->basic_attr.date_code,
      PRST_FIRMWARE_BUILD_DATE,
      ZB_ZCL_STRING_CONST_SIZE(PRST_FIRMWARE_BUILD_DATE));

  ZB_ZCL_SET_STRING_VAL(
      dev_ctx->basic_attr.sw_ver,
      build_id,
      ZB_ZCL_STRING_CONST_SIZE(PRST_FIRMWARE_BUILD_ID));

  dev_ctx->basic_attr.hw_version = CONFIG_PRST_ZB_HARDWARE_VERSION;

  dev_ctx->batt_attrs.quantity = 1;
  dev_ctx->batt_attrs.size = ZB_ZCL_POWER_CONFIG_BATTERY_SIZE_OTHER;

  dev_ctx->identify_attr.identify_time =
      ZB_ZCL_IDENTIFY_IDENTIFY_TIME_DEFAULT_VALUE;
}

zb_zcl_status_t prst_zb_set_attr_value(zb_uint16_t cluster_id, zb_uint16_t attr_id, void* data) {
  return zb_zcl_set_attr_val(PRST_ZIGBEE_ENDPOINT,
                             cluster_id,
                             ZB_ZCL_CLUSTER_SERVER_ROLE,
                             attr_id,
                             (zb_uint8_t*)data,
                             ZB_FALSE);
}
```

## src/prst_zb_attrs.h
```c
#ifndef _PRST_ZB_ATTRS_H_
#define _PRST_ZB_ATTRS_H_

#include <zboss_api_addons.h>

#include "prst_zb_soil_calibration.h"

// Relative humimdity cluster - section 4.7.2.2.1.
typedef struct {
  // 100x relative humidity (mandatory).
  zb_uint16_t rel_humidity;
  // 0x0000 – 0x270f (mandatory).
  zb_uint16_t min_val;
  // 0x0001 – 0x2710 (mandatory).
  zb_uint16_t max_val;
} prst_rel_humidity_attrs_t;

// Power configuration cluster - section 3.3.2.2.3.
typedef struct {
  // Units of 100 mV. 0x00 - 0xff (optional, not reportable :()).
  zb_uint8_t voltage;
  // Units of 0.5%. 0x00 (0%) - 0xc8 (100%) (optional, reportable).
  zb_uint8_t percentage;
  // Whole number of battery cells used to power device
  zb_uint8_t quantity;
  // Enumeration of battery size
  enum zb_zcl_power_config_battery_size_e size;
  // Never raised, but ZBOSS declares the state reportable and reads it when a report is due, so both need storage.
  zb_uint8_t alarm_mask;
  zb_uint32_t alarm_state;
} prst_batt_attrs_t;

// Soil moisture cluster.
typedef struct {
  // 0-100, units of 0.01?
  zb_uint16_t percentage;
} prst_soil_moisture_attrs_t;

// Illuminance cluster - section 4.2.2.2.
typedef struct {
  // 10000 * log_10(lux) + 1.
  zb_uint16_t log_lux;
} prst_illuminancce_attrs_t;

struct zb_device_ctx {
  zb_zcl_basic_attrs_ext_t basic_attr;
  zb_zcl_identify_attrs_t identify_attr;
  zb_zcl_temp_measurement_attrs_t temp_measure_attrs;
  prst_rel_humidity_attrs_t rel_humidity_attrs;
  prst_batt_attrs_t batt_attrs;
  prst_soil_moisture_attrs_t soil_moisture_attrs;
  prst_illuminancce_attrs_t illuminance_attrs;
  prst_soil_calibration_attrs_t soil_calibration_attrs;
};

void prst_zb_attrs_init(struct zb_device_ctx* dev_ctx);

zb_zcl_status_t prst_zb_set_attr_value(zb_uint16_t cluster_id, zb_uint16_t attr_id, void* data);

#endif  // _PRST_ZB_ATTRS_H_
```

## src/prst_zb_endpoint_defs.h
```c
#ifndef _PRST_ZB_H_
#define _PRST_ZB_H_

#include "prst_zb_soil_calibration.h"
#include "prst_zb_soil_moisture_defs.h"

#define PRST_ZIGBEE_ENDPOINT 10
#define PRST_BASIC_MANUF_NAME "b-parasite"

#define PRST_ZB_DEVICE_ID 0x0008
#define PRST_ZB_DEVICE_VERSION 0
#define PRST_ZB_IN_CLUSTER_NUM 8
#define PRST_ZB_OUT_CLUSTER_NUM 0
#define PRST_ZB_CLUSTER_NUM (PRST_ZB_IN_CLUSTER_NUM + PRST_ZB_OUT_CLUSTER_NUM)
// ZBOSS takes a slot per reportable attribute at startup in cluster-list order and restores configured records from
// NVRAM; with no slot left the last cluster (calibration) silently gets no default record and every configReport
// for it fails with FAILURE. Keep well above the number of reportable attributes.
#define PRST_ZB_ATTR_REPORTING_COUNT 20

#define PRST_ZB_DECLARE_CLUSTER_LIST(                                       \
    cluster_list_name,                                                      \
    basic_attr_list,                                                        \
    identify_attr_list,                                                     \
    temp_measurement_attr_list,                                             \
    rel_humidity_attr_list,                                                 \
    batt_att_list,                                                          \
    soil_moisture_attr_list,                                                \
    illuminance_attr_list,                                                  \
    soil_calibration_attr_list)                                             \
  zb_zcl_cluster_desc_t cluster_list_name[] =                               \
      {                                                                     \
          ZB_ZCL_CLUSTER_DESC(                                              \
              ZB_ZCL_CLUSTER_ID_IDENTIFY,                                   \
              ZB_ZCL_ARRAY_SIZE(identify_attr_list, zb_zcl_attr_t),         \
              (identify_attr_list),                                         \
              ZB_ZCL_CLUSTER_SERVER_ROLE,                                   \
              ZB_ZCL_MANUF_CODE_INVALID),                                   \
          ZB_ZCL_CLUSTER_DESC(                                              \
              ZB_ZCL_CLUSTER_ID_BASIC,                                      \
              ZB_ZCL_ARRAY_SIZE(basic_attr_list, zb_zcl_attr_t),            \
              (basic_attr_list),                                            \
              ZB_ZCL_CLUSTER_SERVER_ROLE,                                   \
              ZB_ZCL_MANUF_CODE_INVALID),                                   \
          ZB_ZCL_CLUSTER_DESC(                                              \
              ZB_ZCL_CLUSTER_ID_TEMP_MEASUREMENT,                           \
              ZB_ZCL_ARRAY_SIZE(temp_measurement_attr_list, zb_zcl_attr_t), \
              (temp_measurement_attr_list),                                 \
              ZB_ZCL_CLUSTER_SERVER_ROLE,                                   \
              ZB_ZCL_MANUF_CODE_INVALID),                                   \
          ZB_ZCL_CLUSTER_DESC(                                              \
              ZB_ZCL_CLUSTER_ID_REL_HUMIDITY_MEASUREMENT,                   \
              ZB_ZCL_ARRAY_SIZE(rel_humidity_attr_list, zb_zcl_attr_t),     \
              (rel_humi_attr_list),                                         \
              ZB_ZCL_CLUSTER_SERVER_ROLE,                                   \
              ZB_ZCL_MANUF_CODE_INVALID),                                   \
          ZB_ZCL_CLUSTER_DESC(                                              \
              PRST_ZB_ZCL_ATTR_SOIL_MOISTURE_CLUSTER_ID,                    \
              ZB_ZCL_ARRAY_SIZE(soil_moisture_attr_list, zb_zcl_attr_t),    \
              (soil_moisture_attr_list),                                    \
              ZB_ZCL_CLUSTER_SERVER_ROLE,                                   \
              ZB_ZCL_MANUF_CODE_INVALID),                                   \
          ZB_ZCL_CLUSTER_DESC(                                              \
              ZB_ZCL_CLUSTER_ID_ILLUMINANCE_MEASUREMENT,                    \
              ZB_ZCL_ARRAY_SIZE(illuminance_attr_list, zb_zcl_attr_t),      \
              (illuminance_attr_list),                                      \
              ZB_ZCL_CLUSTER_SERVER_ROLE,                                   \
              ZB_ZCL_MANUF_CODE_INVALID),                                   \
          ZB_ZCL_CLUSTER_DESC(                                              \
              ZB_ZCL_CLUSTER_ID_POWER_CONFIG,                               \
              ZB_ZCL_ARRAY_SIZE(batt_attr_list, zb_zcl_attr_t),             \
              (batt_attr_list),                                             \
              ZB_ZCL_CLUSTER_SERVER_ROLE,                                   \
              ZB_ZCL_MANUF_CODE_INVALID),                                   \
          ZB_ZCL_CLUSTER_DESC(                                              \
              PRST_ZB_ZCL_CLUSTER_ID_SOIL_CALIBRATION,                      \
              ZB_ZCL_ARRAY_SIZE(soil_calibration_attr_list, zb_zcl_attr_t), \
              (soil_calibration_attr_list),                                 \
              ZB_ZCL_CLUSTER_SERVER_ROLE,                                   \
              ZB_ZCL_MANUF_CODE_INVALID)}

#define PRST_ZB_DECLARE_SIMPLE_DESC(ep_name, ep_id, in_clust_num, out_clust_num) \
  ZB_DECLARE_SIMPLE_DESC(in_clust_num, out_clust_num);                           \
  ZB_AF_SIMPLE_DESC_TYPE(in_clust_num, out_clust_num)                            \
  simple_desc_##ep_name =                                                        \
      {                                                                          \
          ep_id,                                                                 \
          ZB_AF_HA_PROFILE_ID,                                                   \
          PRST_ZB_DEVICE_ID,                                                     \
          PRST_ZB_DEVICE_VERSION,                                                \
          0,                                                                     \
          in_clust_num,                                                          \
          out_clust_num,                                                         \
          {                                                                      \
              ZB_ZCL_CLUSTER_ID_BASIC,                                           \
              ZB_ZCL_CLUSTER_ID_IDENTIFY,                                        \
              ZB_ZCL_CLUSTER_ID_TEMP_MEASUREMENT,                                \
              ZB_ZCL_CLUSTER_ID_REL_HUMIDITY_MEASUREMENT,                        \
              PRST_ZB_ZCL_ATTR_SOIL_MOISTURE_CLUSTER_ID,                         \
              ZB_ZCL_CLUSTER_ID_ILLUMINANCE_MEASUREMENT,                         \
              ZB_ZCL_CLUSTER_ID_POWER_CONFIG,                                    \
              PRST_ZB_ZCL_CLUSTER_ID_SOIL_CALIBRATION,                           \
          }}

#define PRST_ZB_DECLARE_ENDPOINT(ep_name, ep_id, cluster_list)                                      \
  ZBOSS_DEVICE_DECLARE_REPORTING_CTX(reporting_ctx_##ep_name, PRST_ZB_ATTR_REPORTING_COUNT);        \
  PRST_ZB_DECLARE_SIMPLE_DESC(ep_name, ep_id,                                                       \
                              PRST_ZB_IN_CLUSTER_NUM, PRST_ZB_OUT_CLUSTER_NUM);                     \
  ZB_AF_DECLARE_ENDPOINT_DESC(ep_name, ep_id, ZB_AF_HA_PROFILE_ID,                                  \
                              /*reserved_length=*/0, /*reserved_ptr=*/NULL,                         \
                              ZB_ZCL_ARRAY_SIZE(cluster_list, zb_zcl_cluster_desc_t), cluster_list, \
                              (zb_af_simple_desc_1_1_t*)&simple_desc_##ep_name,                     \
                              PRST_ZB_ATTR_REPORTING_COUNT, reporting_ctx_##ep_name,                \
                              /*lev_ctrl_count=*/0, /*lev_ctrl_ctx=*/NULL)

#endif  // _PRST_ZB_H_
```

## src/prst_zb_soil_calibration.c
```c
#include "prst_zb_soil_calibration.h"

#include <string.h>
#include <zephyr/fs/fs.h>
#include <zephyr/kernel.h>
#include <zephyr/logging/log.h>
#include <zephyr/sys/util.h>

LOG_MODULE_REGISTER(soil_calibration, CONFIG_LOG_DEFAULT_LEVEL);

#define CALIBRATION_FILE "/lfs/soil_cal"

typedef struct {
  int16_t dry;
  int16_t wet;
} stored_calibration_t;

static stored_calibration_t pending;

// The live attributes, so a write can be checked against the other point.
static const prst_soil_calibration_attrs_t* current;

// ZBOSS stores a written value before the device callback runs and ignores that callback's result; only this
// hook can turn an invalid dry/wet pair into an INVALID_VALUE response instead of accepting it.
static zb_ret_t check_value(zb_uint16_t attr_id, zb_uint8_t endpoint, zb_uint8_t* value) {
  if (attr_id != PRST_ZB_ZCL_ATTR_SOIL_CALIBRATION_DRY_ID &&
      attr_id != PRST_ZB_ZCL_ATTR_SOIL_CALIBRATION_WET_ID) {
    return RET_OK;
  }
  zb_int16_t v;
  memcpy(&v, value, sizeof(v));
  if (current == NULL) {
    return RET_OK;
  }
  if (attr_id == PRST_ZB_ZCL_ATTR_SOIL_CALIBRATION_DRY_ID) {
    return prst_soil_calibration_is_valid(v, current->wet) ? RET_OK : RET_ERROR;
  }
  if (attr_id == PRST_ZB_ZCL_ATTR_SOIL_CALIBRATION_WET_ID) {
    return prst_soil_calibration_is_valid(current->dry, v) ? RET_OK : RET_ERROR;
  }
  return RET_OK;
}

void prst_zcl_soil_calibration_init_server(void) {
  zb_zcl_add_cluster_handlers(PRST_ZB_ZCL_CLUSTER_ID_SOIL_CALIBRATION,
                              ZB_ZCL_CLUSTER_SERVER_ROLE,
                              check_value,
                              /*cluster_write_attr_hook=*/NULL,
                              /*cluster_handler=*/NULL);
}

void prst_zcl_soil_calibration_init_client(void) {
}

// Both points live on the factory scale, where wetter soil reads higher; dry above wet would invert the output.
bool prst_soil_calibration_is_valid(zb_int16_t dry, zb_int16_t wet) {
  return dry < wet;
}

void prst_soil_calibration_load(prst_soil_calibration_attrs_t* attrs) {
  current = attrs;
  attrs->dry = PRST_ZB_SOIL_CALIBRATION_DEFAULT_DRY;
  attrs->wet = PRST_ZB_SOIL_CALIBRATION_DEFAULT_WET;

  struct fs_file_t file;
  fs_file_t_init(&file);
  if (fs_open(&file, CALIBRATION_FILE, FS_O_READ) != 0) {
    return;
  }
  stored_calibration_t stored;
  ssize_t n = fs_read(&file, &stored, sizeof(stored));
  fs_close(&file);
  if (n == sizeof(stored) && prst_soil_calibration_is_valid(stored.dry, stored.wet)) {
    attrs->dry = stored.dry;
    attrs->wet = stored.wet;
  }
}

static void save_work_handler(struct k_work* work) {
  struct fs_file_t file;
  fs_file_t_init(&file);
  if (fs_open(&file, CALIBRATION_FILE, FS_O_CREATE | FS_O_WRITE) != 0) {
    LOG_ERR("Unable to open %s", CALIBRATION_FILE);
    return;
  }
  if (fs_write(&file, &pending, sizeof(pending)) != sizeof(pending)) {
    LOG_ERR("Unable to write %s", CALIBRATION_FILE);
  }
  fs_close(&file);
}

K_WORK_DEFINE(save_work, save_work_handler);

void prst_soil_calibration_save_async(const prst_soil_calibration_attrs_t* attrs) {
  pending.dry = attrs->dry;
  pending.wet = attrs->wet;
  k_work_submit(&save_work);
}

float prst_soil_calibration_apply(const prst_soil_calibration_attrs_t* attrs, float factory_fraction) {
  if (!prst_soil_calibration_is_valid(attrs->dry, attrs->wet)) {
    return MAX(0.0f, MIN(1.0f, factory_fraction));
  }
  const float dry = attrs->dry / 10000.0f;
  const float wet = attrs->wet / 10000.0f;
  return MAX(0.0f, MIN(1.0f, (factory_fraction - dry) / (wet - dry)));
}
```

## src/prst_zb_soil_calibration.h
```c
#ifndef _PRST_ZB_SOIL_CALIBRATION_H_
#define _PRST_ZB_SOIL_CALIBRATION_H_

#include <stdbool.h>
#include <zboss_api.h>
#include <zcl/zb_zcl_common.h>

// Private cluster that rescales the factory air (0%) to water (100%) reading onto the user's own
// "time to water" and "freshly watered" points. All three attributes are in units of 0.01% of
// that factory scale, so soil_raw = 3000 means the factory formula reads 30.00%.
#define PRST_ZB_ZCL_CLUSTER_ID_SOIL_CALIBRATION 0xFC00

#define PRST_ZB_ZCL_ATTR_SOIL_CALIBRATION_RAW_ID 0x0000
#define PRST_ZB_ZCL_ATTR_SOIL_CALIBRATION_DRY_ID 0x0001
#define PRST_ZB_ZCL_ATTR_SOIL_CALIBRATION_WET_ID 0x0002

#define PRST_ZB_ZCL_ATTR_SOIL_VALID_ID 0x0010
#define PRST_ZB_ZCL_ATTR_SENSOR_ERRORS_ID 0x0011
#define PRST_ZB_ZCL_ATTR_BATTERY_MV_ID 0x0012
#define PRST_ZB_ZCL_ATTR_BOOT_COUNT_ID 0x0013
#define PRST_ZB_ZCL_ATTR_RESET_CAUSE_ID 0x0014
#define PRST_ZB_ZCL_ATTR_UPTIME_SEC_ID 0x0015

#define PRST_ZB_SOIL_CALIBRATION_DEFAULT_DRY 0
#define PRST_ZB_SOIL_CALIBRATION_DEFAULT_WET 10000

void prst_zcl_soil_calibration_init_server(void);
void prst_zcl_soil_calibration_init_client(void);

#define PRST_ZB_ZCL_CLUSTER_ID_SOIL_CALIBRATION_SERVER_ROLE_INIT prst_zcl_soil_calibration_init_server
#define PRST_ZB_ZCL_CLUSTER_ID_SOIL_CALIBRATION_CLIENT_ROLE_INIT prst_zcl_soil_calibration_init_client

#define PRST_ZB_ZCL_SOIL_CALIBRATION_CLUSTER_REVISION_DEFAULT ((zb_uint16_t)1)

#define ZB_SET_ATTR_DESCR_WITH_PRST_ZB_ZCL_ATTR_SOIL_CALIBRATION_RAW_ID(data_ptr) \
  {PRST_ZB_ZCL_ATTR_SOIL_CALIBRATION_RAW_ID, ZB_ZCL_ATTR_TYPE_S16,                \
   ZB_ZCL_ATTR_ACCESS_READ_ONLY | ZB_ZCL_ATTR_ACCESS_REPORTING,                   \
   ZB_ZCL_NON_MANUFACTURER_SPECIFIC, (void*)data_ptr}

#define ZB_SET_ATTR_DESCR_WITH_PRST_ZB_ZCL_ATTR_SOIL_CALIBRATION_DRY_ID(data_ptr) \
  {PRST_ZB_ZCL_ATTR_SOIL_CALIBRATION_DRY_ID, ZB_ZCL_ATTR_TYPE_S16,                \
   ZB_ZCL_ATTR_ACCESS_READ_WRITE | ZB_ZCL_ATTR_ACCESS_REPORTING,                  \
   ZB_ZCL_NON_MANUFACTURER_SPECIFIC, (void*)data_ptr}

#define ZB_SET_ATTR_DESCR_WITH_PRST_ZB_ZCL_ATTR_SOIL_CALIBRATION_WET_ID(data_ptr) \
  {PRST_ZB_ZCL_ATTR_SOIL_CALIBRATION_WET_ID, ZB_ZCL_ATTR_TYPE_S16,                \
   ZB_ZCL_ATTR_ACCESS_READ_WRITE | ZB_ZCL_ATTR_ACCESS_REPORTING,                  \
   ZB_ZCL_NON_MANUFACTURER_SPECIFIC, (void*)data_ptr}

#define PRST_ZB_DIAGNOSTIC_ATTR(id, ptr, type) \
  ZB_ZCL_SET_ATTR_DESC_M(id, ptr, type, ZB_ZCL_ATTR_ACCESS_READ_ONLY | ZB_ZCL_ATTR_ACCESS_REPORTING)
#define PRST_ZB_ZCL_DECLARE_SOIL_CALIBRATION_ATTRIB_LIST(attr_list, attrs)                                   \
  ZB_ZCL_START_DECLARE_ATTRIB_LIST_CLUSTER_REVISION(attr_list, PRST_ZB_ZCL_SOIL_CALIBRATION)                 \
  ZB_ZCL_SET_ATTR_DESC(PRST_ZB_ZCL_ATTR_SOIL_CALIBRATION_RAW_ID, &((attrs)->raw))                            \
  ZB_ZCL_SET_ATTR_DESC(PRST_ZB_ZCL_ATTR_SOIL_CALIBRATION_DRY_ID, &((attrs)->dry))                            \
  ZB_ZCL_SET_ATTR_DESC(PRST_ZB_ZCL_ATTR_SOIL_CALIBRATION_WET_ID, &((attrs)->wet))                            \
  PRST_ZB_DIAGNOSTIC_ATTR(PRST_ZB_ZCL_ATTR_SOIL_VALID_ID, &((attrs)->soil_valid), ZB_ZCL_ATTR_TYPE_BOOL)     \
  PRST_ZB_DIAGNOSTIC_ATTR(PRST_ZB_ZCL_ATTR_SENSOR_ERRORS_ID, &((attrs)->sensor_errors), ZB_ZCL_ATTR_TYPE_U8) \
  PRST_ZB_DIAGNOSTIC_ATTR(PRST_ZB_ZCL_ATTR_BATTERY_MV_ID, &((attrs)->battery_mv), ZB_ZCL_ATTR_TYPE_U16)      \
  PRST_ZB_DIAGNOSTIC_ATTR(PRST_ZB_ZCL_ATTR_BOOT_COUNT_ID, &((attrs)->boot_count), ZB_ZCL_ATTR_TYPE_U32)      \
  PRST_ZB_DIAGNOSTIC_ATTR(PRST_ZB_ZCL_ATTR_RESET_CAUSE_ID, &((attrs)->reset_cause), ZB_ZCL_ATTR_TYPE_U32)    \
  PRST_ZB_DIAGNOSTIC_ATTR(PRST_ZB_ZCL_ATTR_UPTIME_SEC_ID, &((attrs)->uptime_sec), ZB_ZCL_ATTR_TYPE_U32)      \
  ZB_ZCL_FINISH_DECLARE_ATTRIB_LIST

typedef struct {
  zb_int16_t raw;
  zb_int16_t dry;
  zb_int16_t wet;
  zb_bool_t soil_valid;
  zb_uint8_t sensor_errors;
  zb_uint16_t battery_mv;
  zb_uint32_t boot_count;
  zb_uint32_t reset_cause;
  zb_uint32_t uptime_sec;
} prst_soil_calibration_attrs_t;

// Fills dry/wet from flash, falling back to the factory scale.
void prst_soil_calibration_load(prst_soil_calibration_attrs_t* attrs);

// Persists dry/wet off the Zigbee thread; flash writes are too slow for a ZCL callback.
void prst_soil_calibration_save_async(const prst_soil_calibration_attrs_t* attrs);

bool prst_soil_calibration_is_valid(zb_int16_t dry, zb_int16_t wet);

// Maps the factory-scale reading (0..1 = air..water, unclamped) onto [0, 1] between dry and wet.
float prst_soil_calibration_apply(const prst_soil_calibration_attrs_t* attrs, float factory_fraction);

#endif  // _PRST_ZB_SOIL_CALIBRATION_H_
```
